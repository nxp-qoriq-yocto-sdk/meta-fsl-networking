## conf/distro/fsl-networking.conf
```bitbake
require conf/distro/poky.conf

DISTRO = "fsl-networking"
DISTRO_NAME = "fsl-networking (QorIQ SDK)"
DISTRO_VERSION = "QorIQ-SDK-V1.8"
SDK_VENDOR = "-fslsdk"
SDK_VERSION = "QorIQ-SDK-V1.8"
MAINTAINER = "Freescale Yocto Team <yocto@linux.freescale.net>"

TARGET_VENDOR = "-fsl"
TARGET_VENDOR_virtclass-multilib-lib32 = "-fsl"
TARGET_VENDOR_virtclass-multilib-lib64 = "-fsl"

SDK_NAME = "${DISTRO}-${TCLIBC}-${SDK_ARCH}-${TUNE_PKGARCH}"

POKY_DEFAULT_DISTRO_FEATURES_remove = " opengl ptest"
DISTRO_FEATURES_DEFAULT_remove = " pcmcia 3g"
DISTRO_FEATURES_DEFAULT_append = " benchmark vfat ext2 mtd \
    alsa perl ppp python usbhost virtualization db \
"

# disable network check to support offline build with sdk iso
CONNECTIVITY_CHECK_URIS = ""

SANITY_TESTED_DISTROS += " \
            CentOS-7.0.1406 \n \
            Debian-7.6 \n \
            LinuxMint-15 \n \
	    "

include conf/distro/include/fsl-networking-base.inc
include conf/distro/include/fsl-networking-sha-references.inc
include conf/include/fsl-toolchain-default-version.inc

INHERIT += "own-mirrors"
SOURCE_MIRROR_URL ?= "http://git.freescale.com/source/"

ERROR_QA = "dev-so debug-deps dev-deps debug-files arch la2 pkgconfig la perms rpaths staticdev ldflags"
```

## conf/distro/include/fsl-networking-base.inc
```bitbake
# Freescale networking BSP default versions
GCCVERSION_ls102xa = "linaro-4.8"
BINUVERSION_ls102xa = "linaro-2.24"
PREFERRED_VERSION_make = "3.81"
PREFERRED_VERSION_eglibc_ls102xa = "linaro-2.19"
PREFERRED_VERSION_nativesdk-eglibc_ls102xa = "linaro-2.19"
PREFERRED_VERSION_libvirt = "1.2.13"

PREFERRED_VERSION_virtual/kernel_ls102xa = "3.12"

EXTRA_IMAGEDEPENDS += "cst-native"

# use xz to compress sstate
SSTATE_PKG_SUFFIX = "txz"
SSTATE_PKG_TARZIPPROG = "xz"

# whiteliste restricted license
LICENSE_FLAGS_WHITELIST = "non-commercial_netperf \
    commercial_libav commercial_x264 \
"

# copy the license.manifest to the image
COPY_LIC_MANIFEST = "1"
```

## conf/distro/include/fsl-networking-default-providers.inc
```bitbake
# Freescale networking BSP default providers

PREFERRED_PROVIDER_virtual/java-native = "jamvm-native"
PREFERRED_PROVIDER_virtual/javac-native = "ecj-bootstrap-native"
PREFERRED_PROVIDER_openjdk-6-jre = "openjdk-6-jre"
```

## conf/distro/include/fsl-networking-default-versions.inc
```bitbake
# Freescale networking BSP default versions

GCCVERSION_ls102xa = "linaro-4.8"
BINUVERSION_ls102xa = "linaro-2.24"
PREFERRED_VERSION_eglibc_ls102xa = "linaro-2.19"
PREFERRED_VERSION_nativesdk-eglibc_ls102xa = "linaro-2.19"

PREFERRED_VERSION_virtual/kernel_ls102xa = "3.12"
```

## conf/layer.conf
```bitbake
# We have a packages directory, add to BBFILES
BBPATH := "${BBPATH}:${LAYERDIR}"

BBFILES += "${LAYERDIR}/recipes-*/*/*.bb*"
BBFILES += "${LAYERDIR}/images/*.bb*"
BBFILES += "${LAYERDIR}/classes/*.bb*"
BBFILES += "${LAYERDIR}/packagegroups/*.bb*"

BBFILE_COLLECTIONS += "fsl-networking"
BBFILE_PATTERN_fsl-networking := "^${LAYERDIR}/"
BBFILE_PRIORITY_fsl-networking = "5"

BB_ENV_EXTRAWHITE := "KSRC USRC"

LICENSE_PATH += "${LAYERDIR}/custom-licenses"

# Let us add layer-specific bbappends which are only applied when that
# layer is included in our configuration
BBFILES += "${@' '.join('${LAYERDIR}/recipes*/%s/*/*.bbappend' % layer \
              for layer in BBFILE_COLLECTIONS.split())}"
```
